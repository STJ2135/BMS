AUTOSAR XML (schema 4-3-0)
standard types defined: Double, float64
