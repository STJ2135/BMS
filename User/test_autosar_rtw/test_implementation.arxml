AUTOSAR XML (schema 4-3-0)
package /test_pkg/test_imp
  swc implementation test: programming-language=C, sw-version=1.4.1, used-code-generator=Embedded Coder 7.0 (R2018a) 06-Feb-2018, vendor-id=0, behavior=test
    code-descriptors:
      code Code
        artifact-descriptors:
          short-label=test_c, category=SWSRC
          short-label=test_data_c, category=SWSRC
          short-label=rtwtypes_h, category=SWHDR
          short-label=test_h, category=SWHDR
    resource consumption RsrcCons_test
