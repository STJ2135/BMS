AUTOSAR XML (schema 4-3-0)
package /test_pkg/test_if
  21 x sender receiver interface:
    current
      data current: category=VALUE, sw-calibration-access=READ-ONLY, type=Double
    voltage_V1
      data voltage_V1: category=VALUE, sw-calibration-access=READ-ONLY, type=Double
    voltage_V2
      data voltage_V2: category=VALUE, sw-calibration-access=READ-ONLY, type=Double
    voltage_V3
      data voltage_V3: category=VALUE, sw-calibration-access=READ-ONLY, type=Double
    voltage_V4
      data voltage_V4: category=VALUE, sw-calibration-access=READ-ONLY, type=Double
    voltage_V5
      data voltage_V5: category=VALUE, sw-calibration-access=READ-ONLY, type=Double
    BMS_CmdOpenBalan
      data BMS_CmdOpenBalan: category=VALUE, sw-calibration-access=READ-ONLY, type=Double
    BMS_CmdOpenCHG
      data BMS_CmdOpenCHG: category=VALUE, sw-calibration-access=READ-ONLY, type=Double
    BMS_CmdOpenDSG
      data BMS_CmdOpenDSG: category=VALUE, sw-calibration-access=READ-ONLY, type=Double
    BMS_Cmd
      data BMS_Cmd: category=VALUE, sw-calibration-access=READ-ONLY, type=Double
    Batt_State
      data Batt_State: category=VALUE, sw-calibration-access=READ-ONLY, type=Double
    SOC
      data SOC: category=VALUE, sw-calibration-access=READ-ONLY, type=Double
    OutCurrent
      data OutCurrent: category=VALUE, sw-calibration-access=READ-ONLY, type=Double
    OutBus_Voltage
      data OutBus_Voltage: category=VALUE, sw-calibration-access=READ-ONLY, type=Double
    OutCmdCloseCHG
      data OutCmdCloseCHG: category=VALUE, sw-calibration-access=READ-ONLY, type=Double
    OutCmdOpenCHG
      data OutCmdOpenCHG: category=VALUE, sw-calibration-access=READ-ONLY, type=Double
    OutCmdOpenBalan
      data OutCmdOpenBalan: category=VALUE, sw-calibration-access=READ-ONLY, type=Double
    OutCmdCloseBalan
      data OutCmdCloseBalan: category=VALUE, sw-calibration-access=READ-ONLY, type=Double
    OutCmdOpenDSG
      data OutCmdOpenDSG: category=VALUE, sw-calibration-access=READ-ONLY, type=Double
    OutCmdCloseDSG
      data OutCmdCloseDSG: category=VALUE, sw-calibration-access=READ-ONLY, type=Double
    Batt_Fault
      data Batt_Fault: category=VALUE, sw-calibration-access=READ-ONLY, type=Double
